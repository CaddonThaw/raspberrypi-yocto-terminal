/dts-v1/;
/plugin/;

/ {
    compatible = "brcm,bcm2835";

    fragment@0 {
        target = <&spidev0>;
        __overlay__ {
            status = "disabled";
        };
    };

    fragment@1 {
        target = <&spi0>;
        __overlay__ {
            #address-cells = <1>;
            #size-cells = <0>;
            status = "okay";

            st7789: st7789@0 {
                compatible = "sitronix,st7789v";
                reg = <0>;
                spi-max-frequency = <40000000>;
                
                dc-gpios = <&gpio 24 0>;
                reset-gpios = <&gpio 25 0>;
                led-gpios = <&gpio 23 0>;
                
                width = <320>;
                height = <240>;
                buswidth = <8>;
                rotate = <90>;
                fps = <60>;
                bgr = <0>;
                debug = <0>;
            };
        };
    };
};

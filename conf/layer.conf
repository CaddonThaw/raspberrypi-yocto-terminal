## conf/layer.conf
```bitbake
# We have a conf and classes directory, add to BBPATH
BBPATH .= ":${LAYERDIR}"

# We have recipes-* directories, add to BBFILES
BBFILES += "${LAYERDIR}/recipes-*/*/*.bb \
            ${LAYERDIR}/recipes-*/*/*.bbappend"

BBFILE_COLLECTIONS += "raspberrypi-yocto-terminal"
BBFILE_PATTERN_raspberrypi-yocto-terminal = "^${LAYERDIR}/"
BBFILE_PRIORITY_raspberrypi-yocto-terminal = "6"

LAYERDEPENDS_raspberrypi-yocto-terminal = "core"
LAYERSERIES_COMPAT_raspberrypi-yocto-terminal = "scarthgap"
```
